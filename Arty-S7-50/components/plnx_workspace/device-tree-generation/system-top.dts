/*
 * CAUTION: This file is automatically generated by Xilinx.
 * Version:  
 * Today is: Tue Nov 21 11:01:57 2017
*/


/dts-v1/;
/include/ "pl.dtsi"
/ {
	chosen {
		bootargs = "earlycon";
		stdout-path = "serial0:115200n8";
	};
	aliases {
		serial0 = &axi_uartlite_0;
		spi0 = &axi_quad_spi_0;
	};
	memory {
		device_type = "memory";
		reg = <0x80000000 0x10000000>;
	};
};
#include "system-user.dtsi"
