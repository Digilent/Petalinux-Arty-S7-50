## Arty-S7-50/project-spec/meta-plnx-generated/conf/machine/plnx_microblaze.conf
```bitbake
require conf/machine/include/tune-microblaze.inc
require conf/machine/include/machine-xilinx-board.inc
require conf/machine/include/machine-xilinx-default.inc

PREFERRED_PROVIDER_virtual/kernel = "linux-xlnx"
PREFERRED_PROVIDER_virtual/bootloader = "u-boot-xlnx"
PREFERRED_PROVIDER_virtual/dtb = "device-tree-generation"
PREFERRED_PROVIDER_virtual/hdf = "external-hdf"
PREFERRED_PROVIDER_virtual/bitstream = "bitstream-extraction"
EXTRA_IMAGEDEPENDS += "device-tree-generation"
PREFERRED_PROVIDER_virtual/fsboot = "fs-boot"
PREFERRED_PROVIDER_virtual/elfrealloc = "mb-realoc"
TUNE_FEATURES_tune-microblaze += "v10.0 little-endian barrel-shift pattern-compare multiply-high divide-hard"
EXTRA_IMAGEDEPENDS += "fs-boot"
EXTRA_IMAGEDEPENDS += "mb-realoc"
UBOOT_MACHINE = "microblaze-generic_config"
INITRAMFS_IMAGE_BUNDLE = "1"
INITRAMFS_IMAGE = "petalinux-user-image"
IMAGE_FSTYPES_append = " tar.gz cpio cpio.gz"
INITRAMFS_MAXSIZE = "524288"
SERIAL_CONSOLE = "115200 ttyUL0"
MACHINE_EXTRA_RRECOMMENDS += " kernel-modules"
MACHINE_FEATURES = ""
SERIAL_CONSOLES_CHECK = "${SERIAL_CONSOLES}"
```
